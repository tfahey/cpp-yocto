## build/conf/local.conf
```bitbake
MACHINE = "qemux86-64"
IMAGE_INSTALL:append = " hello-world"
EXTRA_IMAGE_FEATURES ?= "debug-tweaks"
USER_CLASSES ?= "buildstats"
PATCHRESOLVE = "noop"
CONF_VERSION = "2"
```

## veracode-package/cpp-yocto-qt5/meta-hello-qt/conf/layer.conf
```bitbake
# Layer configuration for meta-hello-qt
# This file tells Yocto about our custom layer

BBPATH .= ":${LAYERDIR}"

BBFILES += "${LAYERDIR}/recipes-*/*/*.bb"
BBFILES += "${LAYERDIR}/recipes-*/*/*.bbappend"

BBFILE_COLLECTIONS += "meta-hello-qt"
BBFILE_PATTERN_meta-hello-qt = "^${LAYERDIR}/"
BBFILE_PRIORITY_meta-hello-qt = "10"

LAYERSERIES_COMPAT_meta-hello-qt = "scarthgap"
```
